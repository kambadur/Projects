/ {
	amba_pl: amba_pl {
		ranges;
		compatible = "simple-bus";
		#address-cells = <1>;
		#size-cells = <1>;
		firmware-name = "design_1_wrapper.bit.bin";
		clocking0: clocking0 {
			compatible = "xlnx,fclk";
			assigned-clocks = <&clkc 15>;
			assigned-clock-rates = <100000000>;
			#clock-cells = <0>;
			clock-output-names = "fabric_clk";
			clocks = <&clkc 15>;
		};
		myip_spi_controller_0: myip_spi_controller@43c00000 {
			xlnx,rable = <0>;
			xlnx,s00-axi-data-width = <32>;
			compatible = "xlnx,myip-spi-controller-1.0";
			status = "okay";
			clock-names = "s00_axi_aclk";
			xlnx,s00-axi-addr-width = <4>;
			xlnx,ip-name = "myip_spi_controller";
			xlnx,edk-iptype = "PERIPHERAL";
			reg = <0x43c00000 0x80>;
			clocks = <&clkc 15>;
			xlnx,name = "myip_spi_controller_0";
		};
	};
};
